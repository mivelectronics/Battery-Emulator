#include "miv_web.h"

#ifndef CAN_VIA_LINK
// Only the boards with the S32K link (miv_esp32eth_330) carry these pages: the upstream boards keep their
// RAM and flash.
void init_miv_web(AsyncWebServer&) {}
#else

#include <Arduino.h>
#include <errno.h>
#include <memory>
#include <freertos/FreeRTOS.h>
#include <freertos/semphr.h>
#include <stdarg.h>
#include <stdio.h>
#include <string.h>

#include "../../../battery/BATTERIES.h"
#include "../../../communication/can/can_link.h"
#include "../../../communication/link/be_link.h"
#include "../../../communication/link/be_snapshot.h"
#include "../../../communication/link/s32k_ota.h"
#include "../../../communication/link/s32k_store.h"
#include "../../../communication/nvm/comm_nvm.h"
#include "../../../datalayer/datalayer.h"
#include "../../../devboard/safety/safety.h"
#include "../../../devboard/utils/events.h"
#include "../../../devboard/utils/millis64.h"
#include "../../../inverter/INVERTERS.h"
#include "../webserver.h"
#ifdef ETHERNET_W5500
#include "../../ethernet/eth_w5500.h"
#endif
#include "miv_page_gz.h"  // generated by gen_page.py from miv_page.html

/* ---- A small JSON writer into a fixed buffer: no allocation per request --------------------------------- */
class JsonOut {
 public:
  JsonOut(char* buf, size_t cap) : b(buf), cap(cap) { b[0] = 0; }

  void open(char c) {
    raw("%c", c);
    first = true;
  }
  void close(char c) {
    raw("%c", c);
    first = false;
  }
  void key(const char* k) {
    raw(first ? "\"%s\":" : ",\"%s\":", k);
    first = false;
  }
  void item() {
    if (!first) {
      raw(",");
    }
    first = false;
  }
  void null(const char* k) {
    key(k);
    raw("null");
  }
  void boolean(const char* k, bool v) {
    key(k);
    raw(v ? "true" : "false");
  }
  void num(const char* k, long v) {
    key(k);
    raw("%ld", v);
  }
  void unum(const char* k, unsigned long v) {
    key(k);
    raw("%lu", v);
  }
  // fixed point: v / 10^dec
  void fix(const char* k, long v, int dec) {
    key(k);
    fixval(v, dec);
  }
  void fixval(long v, int dec) {
    if (dec == 0) {
      raw("%ld", v);
      return;
    }
    const long div = dec == 1 ? 10 : 100;
    const char* sign = v < 0 ? "-" : "";
    const unsigned long a = v < 0 ? -v : v;
    raw(dec == 1 ? "%s%lu.%01lu" : "%s%lu.%02lu", sign, a / div, a % div);
  }
  void str(const char* k, const char* v) {
    key(k);
    strval(v);
  }
  void strval(const char* v) {
    raw("\"");
    for (const char* p = v ? v : ""; *p; p++) {
      const unsigned char c = (unsigned char)*p;
      if (c == '"' || c == '\\') {
        raw("\\%c", c);
      } else if (c < 0x20) {
        raw("\\u%04x", c);
      } else {
        raw("%c", c);
      }
    }
    raw("\"");
  }
  void raw(const char* fmt, ...) {
    if (n >= cap) {
      return;
    }
    va_list ap;
    va_start(ap, fmt);
    const int w = vsnprintf(b + n, cap - n, fmt, ap);
    va_end(ap);
    n = (w < 0 || n + w >= cap) ? cap : n + w;
  }
  bool overflow() const { return n >= cap; }
  size_t len() const { return n; }

 private:
  char* b;
  size_t cap;
  size_t n = 0;
  bool first = true;
};

static const char* system_status_name(int s) {
  switch (s) {
    case STANDBY:
      return "STANDBY";
    case INACTIVE:
      return "INACTIVE";
    case ACTIVE:
      return "ACTIVE";
    case FAULT:
      return "FAULT";
    case UPDATING:
      return "UPDATING";
    default:
      return "UNKNOWN";
  }
}

static const char* precharge_name(int s) {
  static const char* const names[] = {"IDLE", "START", "PRECHARGING", "OFF", "COMPLETED", "FAILURE"};
  return (s >= 0 && s < 6) ? names[s] : "UNKNOWN";
}

static const char* reset_cause_name(int c) {
  static const char* const names[] = {"power_on", "requested", "wdt", "fault", "wdt_hw", "reset_pin", "other"};
  return (c >= 0 && c < 7) ? names[c] : "other";
}

static const char* can_state_name(int s) {
  static const char* const names[] = {"error-active", "error-warning", "error-passive", "bus-off", "stopped"};
  return (s >= 0 && s < 5) ? names[s] : "unknown";
}

static DATALAYER_BATTERY_TYPE* pack_data(int pack) {
  return pack == 3 ? &datalayer.battery3 : (pack == 2 ? &datalayer.battery2 : &datalayer.battery);
}

static bool pack_present(int pack) {
  return pack == 1 ? battery != nullptr : (pack == 2 ? battery2 != nullptr : battery3 != nullptr);
}

// The same keys for every pack, with a prefix: always written, null while the pack is not there
static void write_pack(JsonOut& j, const char* prefix, int pack) {
  static const char* const keys[] = {
      "alive",       "soc_pct",     "soc_real_pct", "soh_pct",    "voltage_V",   "current_A",   "power_W",
      "capacity_Wh", "remaining_Wh", "chg_lim_W",   "dis_lim_W",  "chg_lim_A",   "dis_lim_A",   "temp_min_C",
      "temp_max_C",  "cell_max_mV", "cell_min_mV",  "cell_dev_mV", "cells",      "bms_status",  "balancing",
      "insulation_kohm"};
  char k[32];
  auto K = [&](const char* name) {
    snprintf(k, sizeof(k), "%s%s", prefix, name);
    return k;
  };
  if (!pack_present(pack)) {
    for (const char* name : keys) {
      j.null(K(name));
    }
    return;
  }
  const auto& i = pack_data(pack)->info;
  const auto& s = pack_data(pack)->status;
  j.boolean(K("alive"), s.CAN_battery_still_alive > 0);
  j.fix(K("soc_pct"), s.reported_soc, 2);
  j.fix(K("soc_real_pct"), s.real_soc, 2);
  j.fix(K("soh_pct"), s.soh_pptt, 2);
  j.fix(K("voltage_V"), s.voltage_dV, 1);
  j.fix(K("current_A"), s.current_dA, 1);
  j.num(K("power_W"), s.active_power_W);
  j.unum(K("capacity_Wh"), i.total_capacity_Wh);
  j.unum(K("remaining_Wh"), s.remaining_capacity_Wh);
  j.unum(K("chg_lim_W"), s.max_charge_power_W);
  j.unum(K("dis_lim_W"), s.max_discharge_power_W);
  j.fix(K("chg_lim_A"), s.max_charge_current_dA, 1);
  j.fix(K("dis_lim_A"), s.max_discharge_current_dA, 1);
  j.fix(K("temp_min_C"), s.temperature_min_dC, 1);
  j.fix(K("temp_max_C"), s.temperature_max_dC, 1);
  j.unum(K("cell_max_mV"), s.cell_max_voltage_mV);
  j.unum(K("cell_min_mV"), s.cell_min_voltage_mV);
  j.num(K("cell_dev_mV"), (long)s.cell_max_voltage_mV - (long)s.cell_min_voltage_mV);
  j.unum(K("cells"), i.number_of_cells);
  j.num(K("bms_status"), (int)s.real_bms_status);
  j.num(K("balancing"), (int)s.balancing_status);
  if (s.insulation_resistance_available) {
    j.unum(K("insulation_kohm"), s.insulation_resistance_kOhm);
  } else {
    j.null(K("insulation_kohm"));
  }
}

// Measured: about 2.3 kB without events, 80 bytes per event: 16 of them stay well inside status_buf
static constexpr int STATUS_MAX_EVENTS = 16;

static void write_status(JsonOut& j) {
  const auto& st = datalayer.system.status;
  const auto& info = datalayer.system.info;
  const auto& ag = datalayer.aggregate;
  const bool remote = be_remote_active();
  const uint32_t age = be_remote_snapshot_age_ms();

  j.open('{');
  j.num("v", 1);
  j.str("src", remote ? "s32k" : "local");
  j.boolean("link_ok", remote && age < 5000);
  if (remote && age != UINT32_MAX) {
    j.unum("link_age_ms", age);
  } else {
    j.null("link_age_ms");
  }
  j.unum("esp_uptime_s", millis() / 1000);
  j.str("esp_fw", version_number);
  j.unum("esp_heap_B", ESP.getFreeHeap());
  j.unum("esp_heap_min_B", ESP.getMinFreeHeap());
  j.unum("esp_heap_block_B", ESP.getMaxAllocHeap());
#ifdef ETHERNET_W5500
  j.boolean("eth_up", ethernet_w5500_connected());
#else
  j.null("eth_up");
#endif

  j.str("status", system_status_name(st.system_status));
  j.num("status_n", (int)st.system_status);
  j.boolean("contactors", st.contactors_engaged == 1);
  j.num("contactors_n", st.contactors_engaged);
  j.str("precharge", precharge_name((int)st.precharge_status));
  j.boolean("inv_allows", st.inverter_allows_contactor_closing);
  j.boolean("bat_allows", st.battery_allows_contactor_closing);
  j.boolean("equipment_stop", info.equipment_stop_active);
  j.boolean("paused", emulator_pause_status != NORMAL || get_event_pointer(EVENT_PAUSE_BEGIN)->state == EVENT_STATE_ACTIVE);
  j.str("bat_proto", info.battery_protocol);
  j.str("inv_proto", inverter ? inverter->name() : "");
  j.boolean("inv_alive", st.CAN_inverter_still_alive > 0);
  j.num("batteries", (battery ? 1 : 0) + (battery2 ? 1 : 0) + (battery3 ? 1 : 0));

  // What the inverter is told: all packs together
  j.fix("agg_soc_pct", ag.reported_soc, 2);
  j.fix("agg_voltage_V", ag.voltage_dV, 1);
  j.fix("agg_current_A", ag.current_dA, 1);
  j.num("agg_power_W", ag.active_power_W);
  j.unum("agg_chg_lim_W", ag.max_charge_power_W);
  j.unum("agg_dis_lim_W", ag.max_discharge_power_W);

  write_pack(j, "", 1);
  write_pack(j, "b2_", 2);

  // Events
  int count = 0;
  for (int i = 0; i < EVENT_NOF_EVENTS; i++) {
    const EVENTS_STATE_TYPE s = get_event_pointer((EVENTS_ENUM_TYPE)i)->state;
    count += (s == EVENT_STATE_ACTIVE || s == EVENT_STATE_ACTIVE_LATCHED) ? 1 : 0;
  }
  j.num("ev_count", count);
  // Not get_event_level_string(EVENTS_LEVEL_TYPE): it skips 17 characters of a 12 character prefix and
  // lands in the next string ("DEBUG" for INFO, "" for DEBUG)
  static const char* const level_names[] = {"INFO", "DEBUG", "WARNING", "UPDATE", "ERROR"};
  const unsigned level = (unsigned)get_event_level();
  j.str("ev_level", level < 5 ? level_names[level] : "UNKNOWN");
  // The status carries a few active events, errors and warnings first, so that it always fits its buffer;
  // the events view reads the whole log from /miv/api/events
  j.key("ev");
  j.open('[');
  int shown = 0;
  for (int pass = 0; pass < 2; pass++) {
    for (int i = 0; i < EVENT_NOF_EVENTS && shown < STATUS_MAX_EVENTS; i++) {
      const EVENTS_STRUCT_TYPE* e = get_event_pointer((EVENTS_ENUM_TYPE)i);
      if (e->state != EVENT_STATE_ACTIVE && e->state != EVENT_STATE_ACTIVE_LATCHED) {
        continue;
      }
      const char* lv = get_event_level_string((EVENTS_ENUM_TYPE)i);
      const bool serious = strcmp(lv, "ERROR") == 0 || strcmp(lv, "WARNING") == 0;
      if (serious != (pass == 0)) {
        continue;
      }
      j.item();
      j.open('{');
      j.str("name", get_event_enum_string((EVENTS_ENUM_TYPE)i));
      j.str("level", lv);
      j.num("data", e->data);
      j.close('}');
      shown++;
    }
  }
  j.close(']');

  // The S32K itself
  be_s32k_status k = {};
  bool have_k = false;
  uint32_t rev = 0;
  bool have_rev = false;
  have_k = be_remote_s32k_status(&k);  // in bridge mode too: the S32K sends its own status alone
  if (remote) {
    have_rev = be_remote_settings_revision(&rev);
  }
  if (have_rev) {
    j.unum("settings_rev", rev);
  } else {
    j.null("settings_rev");
  }
  if (have_k) {
    k.fw_version[sizeof(k.fw_version) - 1] = 0;
    j.unum("s32k_uptime_s", k.uptime_s);
    j.str("s32k_fw", k.fw_version);
    j.str("s32k_reset", reset_cause_name(k.reset_cause));
    j.unum("s32k_restarts_in_row", k.resets_in_row);
    j.boolean("s32k_lockout", (k.flags & BE_S32K_F_LOCKOUT) != 0);
    j.boolean("s32k_wdt", (k.flags & BE_S32K_F_WDT_RUNNING) != 0);
    j.unum("s32k_tick_max_us", k.tick_max_us);
    j.unum("s32k_rx_drop", k.rx_drops);
    j.unum("s32k_outputs", k.outputs);
    k.image_version[sizeof(k.image_version) - 1] = 0;
    k.update_version[sizeof(k.update_version) - 1] = 0;
    j.str("s32k_image", k.image_version);  // MCUboot version, "" without MCUboot
    j.boolean("s32k_test_image", (k.flags & BE_S32K_F_TEST_IMAGE) != 0);
    j.str("s32k_update", k.update_version);
    j.str("s32k_update_result", (k.flags & BE_S32K_F_UPDATE_INSTALLED)  ? "installed"
                                  : (k.flags & BE_S32K_F_UPDATE_REVERTED) ? "reverted"
                                  : (k.flags & BE_S32K_F_TEST_IMAGE)      ? "on_test"
                                                                          : "");
  } else {
    for (const char* n : {"s32k_uptime_s", "s32k_fw", "s32k_reset", "s32k_restarts_in_row", "s32k_lockout",
                          "s32k_wdt", "s32k_tick_max_us", "s32k_rx_drop", "s32k_outputs", "s32k_image",
                          "s32k_test_image", "s32k_update", "s32k_update_result"}) {
      j.null(n);
    }
  }
  static const char* const can_names[BE_S32K_NUM_CAN] = {"can0", "can1", "can4"};
  for (int c = 0; c < BE_S32K_NUM_CAN; c++) {
    char key[24];
    auto K = [&](const char* f) {
      snprintf(key, sizeof(key), "%s_%s", can_names[c], f);
      return key;
    };
    if (have_k) {
      const be_s32k_can& x = k.can[c];
      j.str(K("state"), can_state_name(x.state));
      j.unum(K("tec"), x.tec);
      j.unum(K("rec"), x.rec);
      j.unum(K("rx"), x.rx);
      j.unum(K("tx"), x.tx_ok);
      j.unum(K("txerr"), x.tx_err);
      j.unum(K("drop"), x.tx_drops);
      j.unum(K("kbps"), x.nominal_kbps);
    } else {
      for (const char* f : {"state", "tec", "rec", "rx", "tx", "txerr", "drop", "kbps"}) {
        j.null(K(f));
      }
    }
  }
  j.close('}');
}

/* ---- /miv/api/status: built at most once a second, the same bytes for every browser -------------------- */
static SemaphoreHandle_t status_lock = nullptr;
static char status_buf[4096];
static uint32_t status_built_ms = 0;
static bool status_valid = false;

static void build_status() {
  for (int tries = 0; tries < 3; tries++) {
    const uint32_t seq = be_remote_apply_seq();
    JsonOut j(status_buf, sizeof(status_buf));
    write_status(j);
    if (j.overflow()) {
      snprintf(status_buf, sizeof(status_buf), "{\"v\":1,\"error\":\"status does not fit %u bytes\"}",
               (unsigned)sizeof(status_buf));
      break;
    }
    // A snapshot part arrived meanwhile: values from two of them could be mixed
    if ((seq & 1u) == 0 && seq == be_remote_apply_seq()) {
      break;
    }
  }
  status_built_ms = millis();
  status_valid = true;
}

static void send_json(AsyncWebServerRequest* request, int code, const char* body) {
  AsyncWebServerResponse* r = request->beginResponse(code, "application/json", body);  // copied
  r->addHeader("Cache-Control", "no-store");
  request->send(r);
}

static void handle_status(AsyncWebServerRequest* request) {
  if (xSemaphoreTake(status_lock, pdMS_TO_TICKS(500)) != pdTRUE) {
    request->send(503, "text/plain", "busy");
    return;
  }
  if (!status_valid || millis() - status_built_ms >= 900) {
    build_status();
  }
  AsyncWebServerResponse* r = request->beginResponse(200, "application/json", status_buf);  // copied
  xSemaphoreGive(status_lock);
  r->addHeader("Cache-Control", "no-store");
  request->send(r);
}

/* ---- /miv/api/cells?b=N ------------------------------------------------------------------------------- */
static void handle_cells(AsyncWebServerRequest* request) {
  const int pack = request->hasParam("b") ? request->getParam("b")->value().toInt() : 1;
  if (pack < 1 || pack > 3) {
    request->send(400, "text/plain", "b must be 1, 2 or 3");
    return;
  }
  // "4123," for every cell, "123," for every balancing one, and the frame
  static char buf[MAX_AMOUNT_CELLS * 6 + MAX_AMOUNT_CELLS * 4 + 128];
  if (xSemaphoreTake(status_lock, pdMS_TO_TICKS(500)) != pdTRUE) {
    request->send(503, "text/plain", "busy");
    return;
  }
  JsonOut j(buf, sizeof(buf));
  j.open('{');
  j.num("v", 1);
  j.num("b", pack);
  if (!pack_present(pack)) {
    j.num("n", 0);
    j.null("mV");
    j.null("balancing");
  } else {
    const auto& d = *pack_data(pack);
    const int n = d.info.number_of_cells > MAX_AMOUNT_CELLS ? MAX_AMOUNT_CELLS : d.info.number_of_cells;
    j.num("n", n);
    j.key("mV");
    j.open('[');
    for (int c = 0; c < n; c++) {
      j.item();
      j.raw("%u", d.status.cell_voltages_mV[c]);
    }
    j.close(']');
    j.key("balancing");
    j.open('[');
    for (int c = 0; c < n; c++) {
      if (d.status.cell_balancing_status[c]) {
        j.item();
        j.raw("%d", c + 1);
      }
    }
    j.close(']');
  }
  j.close('}');
  if (j.overflow()) {
    xSemaphoreGive(status_lock);
    request->send(500, "text/plain", "cell list does not fit");
    return;
  }
  AsyncWebServerResponse* r = request->beginResponse(200, "application/json", buf);  // copied
  xSemaphoreGive(status_lock);
  r->addHeader("Cache-Control", "no-store");
  request->send(r);
}

/* ---- /miv/api/settings -------------------------------------------------------------------------------- */
// The settings the S32K keeps in be_cfg, and the way the upstream settings page saves each of them
enum class SetKind : uint8_t { UInt, Bool, SocMax, SocMin, ChargeA, DischargeA, Scaling };
struct SetDef {
  const char* name;  // in the API
  const char* key;   // stored setting
  SetKind kind;
  uint32_t dflt;     // what comm_nvm.cpp reads when the setting is not stored
};
static constexpr uint32_t CAN_NATIVE_IF = (uint32_t)comm_interface::CanNative;
static const SetDef set_defs[] = {
    {"battery_type", "BATTTYPE", SetKind::UInt, 0},
    {"inverter_type", "INVTYPE", SetKind::UInt, 0},
    {"double_battery", "DBLBTR", SetKind::Bool, 0},
    {"battery_comm", "BATTCOMM", SetKind::UInt, CAN_NATIVE_IF},
    {"battery2_comm", "BATT2COMM", SetKind::UInt, CAN_NATIVE_IF},
    {"inverter_comm", "INVCOMM", SetKind::UInt, CAN_NATIVE_IF},
    {"soc_max_pct", "MAXPERCENTAGE", SetKind::SocMax, 0},
    {"soc_min_pct", "MINPERCENTAGE", SetKind::SocMin, 0},
    {"max_charge_A", "MAXCHARGEAMP", SetKind::ChargeA, 0},
    {"max_discharge_A", "MAXDISCHARGEAMP", SetKind::DischargeA, 0},
    {"soc_scaling", "USE_SCALED_SOC", SetKind::Scaling, 0},
    {"contactor_ctrl", "CNTCTRL", SetKind::Bool, 0},
    {"contactor2_ctrl", "CNTCTRLDBL", SetKind::Bool, 0},
    {"contactor_nc", "NCCONTACTOR", SetKind::Bool, 0},
    {"precharge_ms", "PRECHGMS", SetKind::UInt, 100},
};

static void write_settings(JsonOut& j) {
  BatteryEmulatorSettingsStore store(true);
  const auto& bs = datalayer.battery_settings;
  j.open('{');
  j.num("v", 1);
  const bool remote = be_remote_active();
  uint32_t rev = 0;
  if (remote && be_remote_settings_revision(&rev)) {
    j.unum("settings_rev", rev);
  } else {
    j.null("settings_rev");
  }
  j.boolean("remote", remote);
  for (const SetDef& d : set_defs) {
    switch (d.kind) {
      case SetKind::UInt:
        j.unum(d.name, store.getUInt(d.key, d.dflt));
        break;
      case SetKind::Bool:
        j.boolean(d.name, store.getBool(d.key, d.dflt != 0));
        break;
      case SetKind::SocMax:
        j.fix(d.name, bs.max_percentage, 2);
        break;
      case SetKind::SocMin:
        j.fix(d.name, bs.min_percentage, 2);
        break;
      case SetKind::ChargeA:
        j.fix(d.name, bs.max_user_set_charge_dA, 1);
        break;
      case SetKind::DischargeA:
        j.fix(d.name, bs.max_user_set_discharge_dA, 1);
        break;
      case SetKind::Scaling:
        j.boolean(d.name, bs.soc_scaling_active);
        break;
    }
  }
  j.str("battery_name", datalayer.system.info.battery_protocol);
  j.str("inverter_name", inverter ? inverter->name() : "");
  j.close('}');
}

static void handle_settings_get(AsyncWebServerRequest* request) {
  static char buf[1024];
  JsonOut j(buf, sizeof(buf));
  write_settings(j);
  send_json(request, 200, buf);
}

static bool parse_bool(const String& v) {
  return v == "1" || v == "true" || v == "on";
}

// Form fields with the names of the GET answer. Saved like the settings page does: the stored settings
// through BatteryEmulatorSettingsStore, which forwards them to the S32K, the live ones into the datalayer
// and then store_settings(). The S32K may refuse a combination and sends back the truth: the caller waits
// for settings_rev to move and reads GET again.
static void handle_settings_post(AsyncWebServerRequest* request) {
  static char buf[512];
  constexpr size_t N = sizeof(set_defs) / sizeof(set_defs[0]);
  // First every field is read and checked, then saved: a bad value saves nothing
  bool given[N] = {};
  uint32_t uval[N] = {};
  float fval[N] = {};
  for (size_t k = 0; k < N; k++) {
    const SetDef& d = set_defs[k];
    if (!request->hasParam(d.name, true)) {
      continue;
    }
    const String v = request->getParam(d.name, true)->value();
    const float f = v.toFloat();
    const char* bad = nullptr;
    switch (d.kind) {
      case SetKind::UInt:
        bad = v.toInt() < 0 ? "must not be negative" : nullptr;
        uval[k] = (uint32_t)v.toInt();
        break;
      case SetKind::Bool:
      case SetKind::Scaling:
        uval[k] = parse_bool(v) ? 1 : 0;
        break;
      case SetKind::SocMax:
        bad = (f < 0 || f > 100) ? "must be 0..100" : nullptr;
        break;
      case SetKind::SocMin:
        bad = (f < -10 || f > 100) ? "must be -10..100" : nullptr;
        break;
      case SetKind::ChargeA:
      case SetKind::DischargeA:
        bad = (f < 0 || f > 6000) ? "must be 0..6000" : nullptr;
        break;
    }
    if (bad) {
      request->send(400, "text/plain", String(d.name) + " " + bad);
      return;
    }
    given[k] = true;
    fval[k] = f;
  }
  bool live = false;
  int saved = 0;
  {
    BatteryEmulatorSettingsStore store;
    auto& bs = datalayer.battery_settings;
    for (size_t k = 0; k < N; k++) {
      if (!given[k]) {
        continue;
      }
      const SetDef& d = set_defs[k];
      switch (d.kind) {
        case SetKind::UInt:
          store.saveUInt(d.key, uval[k]);
          break;
        case SetKind::Bool:
          store.saveBool(d.key, uval[k] != 0);
          break;
        case SetKind::SocMax:
          bs.max_percentage = static_cast<uint16_t>(fval[k] * 100);
          live = true;
          break;
        case SetKind::SocMin:
          bs.min_percentage = static_cast<int16_t>(fval[k] * 100);
          live = true;
          break;
        case SetKind::ChargeA:
          bs.max_user_set_charge_dA = static_cast<uint16_t>(fval[k] * 10);
          live = true;
          break;
        case SetKind::DischargeA:
          bs.max_user_set_discharge_dA = static_cast<uint16_t>(fval[k] * 10);
          live = true;
          break;
        case SetKind::Scaling:
          bs.soc_scaling_active = uval[k] != 0;
          live = true;
          break;
      }
      saved++;
    }
  }  // the store closes here, before store_settings() opens it again
  if (live) {
    store_settings();
  }
  JsonOut j(buf, sizeof(buf));
  j.open('{');
  j.num("v", 1);
  j.num("saved", saved);
  uint32_t rev = 0;
  if (be_remote_active() && be_remote_settings_revision(&rev)) {
    j.unum("settings_rev", rev);  // wait for a different one
  } else {
    j.null("settings_rev");
  }
  j.close('}');
  send_json(request, 202, buf);
}

/* ---- /miv/api/events: the upstream event log, newest first, as the upstream events page lists it ------
   With the core on the S32K its active events are mirrored into this list (be_snapshot.cpp), so the list is
   one; their count and time are those of the mirror on this chip. */
static int write_events(JsonOut& j) {
  static uint8_t order[EVENT_NOF_EVENTS];  // ids, newest first
  const auto ts = [](uint8_t id) { return get_event_pointer((EVENTS_ENUM_TYPE)id)->timestamp; };
  int n = 0;
  for (int i = 0; i < EVENT_NOF_EVENTS; i++) {
    if (get_event_pointer((EVENTS_ENUM_TYPE)i)->occurences > 0) {
      order[n++] = (uint8_t)i;
    }
  }
  // few of them, so a plain insertion sort
  for (int a = 1; a < n; a++) {
    for (int b = a; b > 0 && ts(order[b]) > ts(order[b - 1]); b--) {
      const uint8_t t = order[b];
      order[b] = order[b - 1];
      order[b - 1] = t;
    }
  }
  static const char* const state_names[] = {"pending", "inactive", "active", "latched"};
  const uint64_t now = millis64();
  j.open('{');
  j.num("v", 1);
  j.num("count", n);
  j.key("ev");
  j.open('[');
  for (int k = 0; k < n; k++) {
    const EVENTS_ENUM_TYPE id = (EVENTS_ENUM_TYPE)order[k];
    const EVENTS_STRUCT_TYPE* e = get_event_pointer(id);
    j.item();
    j.open('{');
    j.str("name", get_event_enum_string(id));
    j.str("level", get_event_level_string(id));
    j.str("state", (unsigned)e->state < 4 ? state_names[e->state] : "unknown");
    j.unum("count", e->occurences);
    j.unum("ago_ms", (unsigned long)(now - e->timestamp));
    j.num("data", e->data);
    j.str("msg", get_event_message_string(id).c_str());
    j.close('}');
  }
  j.close(']');
  j.close('}');
  return n;
}

static void handle_events(AsyncWebServerRequest* request) {
  // The messages make it a few kB: built on the heap and sent from there, freed when the response is gone
  for (size_t cap = 8192; cap <= 32768; cap *= 2) {
    std::shared_ptr<char> buf((char*)malloc(cap), free);
    if (!buf) {
      request->send(503, "text/plain", "no memory");
      return;
    }
    JsonOut j(buf.get(), cap);
    write_events(j);
    if (j.overflow()) {
      continue;
    }
    const size_t len = j.len();
    AsyncWebServerResponse* r = request->beginResponse(
        "application/json", len, [buf, len](uint8_t* out, size_t max, size_t index) -> size_t {
          const size_t n = (len - index) < max ? (len - index) : max;
          memcpy(out, buf.get() + index, n);
          return n;
        });
    r->addHeader("Cache-Control", "no-store");
    request->send(r);
    return;
  }
  request->send(500, "text/plain", "event list too long");
}

// The same as the upstream /clearevents, which answers with a page instead
static void handle_events_clear(AsyncWebServerRequest* request) {
  reset_all_events();
  if (be_remote_active()) {
    be_remote_cmd(BE_CMD_CLEAR_EVENTS, 0, 0);
  }
  send_json(request, 200, "{\"v\":1,\"cleared\":true}");
}

/* ---- /miv/api/s32k/ota/...: update of the S32K's application (s32k_ota.h, OTA_PLAN.md section 4) ----------
 * POST begin?size=N   body: the first 32 bytes of zephyr.signed.bin (its MCUboot header)
 * POST chunk?offset=N body: the next piece (4 KB); 503 when the buffer is full (send it again), 409 on an error
 * POST finish         every piece is in: the S32K checks and marks the image, then restarts
 * POST abort
 * GET  state          progress; every answer above carries the same fields
 * Body callbacks run before the global middleware decides, so they check the access themselves. */
static AsyncWebServerRequest* ota_req = nullptr;  // the request the body below belongs to
static int ota_req_status = 0;
static uint32_t ota_req_offset = 0;

static uint32_t param_u32(AsyncWebServerRequest* request, const char* name) {
  return request->hasParam(name) ? strtoul(request->getParam(name)->value().c_str(), nullptr, 10) : 0;
}

static void send_ota(AsyncWebServerRequest* request, int code, int error) {
  s32k_ota_state s;
  s32k_ota_get(&s);
  static const char* const phases[] = {"idle", "starting", "sending", "checking", "done", "failed"};
  char buf[512];
  JsonOut j(buf, sizeof(buf));
  j.open('{');
  j.num("error", error != 0 ? error : s.error);
  j.str("text", s32k_ota_error_text(error != 0 ? error : s.error));
  j.str("phase", s.phase < 6 ? phases[s.phase] : "?");
  j.unum("total", s.total);
  j.unum("received", s.received);
  j.unum("written", s.written);
  j.unum("elapsed_ms", s.elapsed_ms);
  j.unum("repeats", s.repeats);
  j.str("version", s.version);
  j.boolean("link", can_link_alive());
  j.close('}');
  send_json(request, code, buf);
}

static void ota_begin_body(AsyncWebServerRequest* request, uint8_t* data, size_t len, size_t index, size_t total) {
  if (!webserver_request_authorized(request) || index != 0) {
    return;
  }
  ota_req = request;
  ota_req_status = s32k_ota_begin(data, len, param_u32(request, "size"));
}

static void ota_begin(AsyncWebServerRequest* request) {
  const int e = ota_req == request ? ota_req_status : BE_OTA_E_NOT_IMAGE;
  ota_req = nullptr;
  send_ota(request, e == 0 ? 200 : 409, e);
}

static void ota_chunk_body(AsyncWebServerRequest* request, uint8_t* data, size_t len, size_t index, size_t total) {
  if (!webserver_request_authorized(request)) {
    return;
  }
  if (index == 0) {
    ota_req = request;
    ota_req_offset = param_u32(request, "offset");
    s32k_ota_state s;
    s32k_ota_get(&s);
    ota_req_status = ota_req_offset != s.received ? S32K_OTA_E_OFFSET : s32k_ota_room() < total ? -EAGAIN : 0;
  }
  if (ota_req == request && ota_req_status == 0) {
    ota_req_status = s32k_ota_chunk(ota_req_offset + index, data, len);
  }
}

static void ota_chunk(AsyncWebServerRequest* request) {
  const int e = ota_req == request ? ota_req_status : S32K_OTA_E_OFFSET;
  ota_req = nullptr;
  send_ota(request, e == 0 ? 200 : e == -EAGAIN ? 503 : 409, e == -EAGAIN ? 0 : e);
}

static void ota_finish(AsyncWebServerRequest* request) {
  const int e = s32k_ota_finish();
  send_ota(request, e == 0 ? 200 : 409, e);
}

static void ota_abort(AsyncWebServerRequest* request) {
  s32k_ota_abort();
  send_ota(request, 200, 0);
}

static void ota_state(AsyncWebServerRequest* request) {
  send_ota(request, 200, 0);
}

/* GET /miv/api/s32k/store: the copies kept on an 8 MB ESP32; POST /miv/api/s32k/store/install?slot=N sends
 * one of them again (answers like the routes above) */
static void store_get(AsyncWebServerRequest* request) {
  char buf[512];
  JsonOut j(buf, sizeof(buf));
  j.open('{');
  j.boolean("available", s32k_store_available());
  j.key("slots");
  j.open('[');
  for (int s = 0; s < 2; s++) {
    s32k_store_info i;
    if (!s32k_store_get(s, &i)) {
      continue;
    }
    j.item();
    j.open('{');
    j.num("slot", s);
    j.str("state", s32k_store_state_name(i.state));
    j.str("version", i.version);
    j.unum("size", i.size);
    j.unum("counter", i.counter);
    j.close('}');
  }
  j.close(']');
  j.close('}');
  send_json(request, 200, buf);
}

static void store_install(AsyncWebServerRequest* request) {
  const int e = s32k_ota_install(request->hasParam("slot") ? request->getParam("slot")->value().toInt() : -1);
  send_ota(request, e == 0 ? 200 : 409, e);
}

/* ---- the page ----------------------------------------------------------------------------------------- */
static void handle_page(AsyncWebServerRequest* request) {
  AsyncWebServerResponse* r = request->beginResponse(200, "text/html", miv_page_gz, sizeof(miv_page_gz));
  r->addHeader("Content-Encoding", "gzip");
  r->addHeader("Cache-Control", "no-cache");
  request->send(r);
}

void init_miv_web(AsyncWebServer& server) {
  if (status_lock == nullptr) {
    status_lock = xSemaphoreCreateMutex();
  }
  server.on("/miv/api/status", HTTP_GET, handle_status);
  server.on("/miv/api/cells", HTTP_GET, handle_cells);
  server.on("/miv/api/settings", HTTP_GET, handle_settings_get);
  server.on("/miv/api/settings", HTTP_POST, handle_settings_post);
  server.on("/miv/api/events/clear", HTTP_POST, handle_events_clear);
  server.on("/miv/api/events", HTTP_GET, handle_events);
  server.on("/miv/api/s32k/ota/begin", HTTP_POST, ota_begin, nullptr, ota_begin_body);
  server.on("/miv/api/s32k/ota/chunk", HTTP_POST, ota_chunk, nullptr, ota_chunk_body);
  server.on("/miv/api/s32k/ota/finish", HTTP_POST, ota_finish);
  server.on("/miv/api/s32k/ota/abort", HTTP_POST, ota_abort);
  server.on("/miv/api/s32k/ota/state", HTTP_GET, ota_state);
  server.on("/miv/api/s32k/store/install", HTTP_POST, store_install);
  server.on("/miv/api/s32k/store", HTTP_GET, store_get);
  // One page for /miv and everything under it that is not an API route above (a handler without a
  // wildcard also takes the paths below it, and the first one registered wins): the script picks the view
  // from the path (/miv/, /miv/settings, /miv/cells, /miv/events, /miv/update)
  server.on("/miv", HTTP_GET, handle_page);
}

#endif  // CAN_VIA_LINK
