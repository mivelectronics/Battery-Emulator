## s32k/boards/miv/miv_be_main/board.yml
```yaml
board:
  name: miv_be_main
  full_name: MIV Battery-Emulator main board (be_main)
  vendor: miv
  socs:
    - name: mcxe317
```

## s32k/boards/miv/miv_be_main/dts/bindings/miv,gpio-lines.yaml
```yaml
# SPDX-License-Identifier: GPL-3.0-or-later
description: |
  The GPIO lines of a MIV board, each child one signal of the schematic, named as there. The
  application takes the lines by their labels instead of port and pin numbers.

compatible: "miv,gpio-lines"

child-binding:
  description: One GPIO line of the board
  properties:
    gpios:
      type: phandle-array
      required: true
    output-off-at-start:
      type: boolean
      description: |
        Driven to its inactive level by the application at start (s32k/app/emulator/src/board_lines.c).
        Without it the line stays as the reset leaves it (input, not driven) until a driver takes it.
```

## s32k/boards/miv/miv_be_main/miv_be_main_defconfig
```kconfig
# SPDX-License-Identifier: GPL-3.0-or-later
CONFIG_CONSOLE=y
CONFIG_UART_CONSOLE=y
CONFIG_SERIAL=y
CONFIG_GPIO=y
CONFIG_UART_INTERRUPT_DRIVEN=y
```

## s32k/boards/nxp/frdm_a_s32k312/board.yml
```yaml
board:
  name: frdm_a_s32k312
  full_name: FRDM-A-S32K312
  vendor: nxp
  socs:
    - name: mcxe317
```

## s32k/modules/miv_boot/Kconfig
```kconfig
# SPDX-License-Identifier: GPL-3.0-or-later

config MIV_BOOT_HOOKS
	bool "MIV hooks for MCUboot on the S32K312"
	default n
	help
	  For the MCUboot image only (the application has its own): the MPU map of the S32K312 against
	  the speculative access hang (NXP ERR011573), and SWT0 started by MCUboot with a 10 s timeout and
	  fed during long flash work, so that an image which hangs before it starts its own watchdog is
	  reset and swapped back.

config MIV_BOOT_SLOW_SWAP
	bool "Test build: a slow, visible swap for the power-cut tests"
	depends on MIV_BOOT_HOOKS
	help
	  Never in a release. Slows every step of a swap down and blinks the red LED during it, so that the
	  power can be cut in the middle of a swap by hand (miv_boot_slow_swap.c, slow_swap.conf,
	  tools/build_ota.sh prodslow). Needs CONFIG_MCUBOOT_ACTION_HOOKS.

config MIV_BOOT_SLOW_SWAP_US
	int "Wait per swap step, us"
	depends on MIV_BOOT_SLOW_SWAP
	default 3000
```
